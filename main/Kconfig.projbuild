## main/Kconfig.projbuild
```kconfig
menu "Wamon Configuration"

    config USE_HARDCODED_SETUP_CODE
        bool "Use hard-coded setup code"
        default y
        help
            HomeKit does not recommend having the setup code programmed in the accessory as is.
            Instead, it expects setup info (salt-verifier pair) generated for the given setup code.
            Use this option only for testing purposes. For production, the setup info should be
            used.

    config HOMEKIT_HARDCODE_SETUP_CODE
        string "HomeKit Setup Code"
        default "111-22-333"
        depends on USE_HARDCODED_SETUP_CODE
        help
            Setup code to be used for HomeKot pairing, if hard-coded setup code is enabled.

    config HOMEKIT_HARDCODE_SETUP_ID
        string "HomeKit Setup Id"
        default "ES32"
        depends on USE_HARDCODED_SETUP_CODE
        help
            Setup id to be used for HomeKot pairing, if hard-coded setup code is enabled.

endmenu
```
